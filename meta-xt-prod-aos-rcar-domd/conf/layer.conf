## meta-xt-prod-aos-rcar-domd/conf/layer.conf
```bitbake
# We have a conf and classes directory, add to BBPATH
BBPATH .= ":${LAYERDIR}"

# We have a packages directory, add to BBFILES
BBFILES += "${LAYERDIR}/recipes-*/*/*.bb \
            ${LAYERDIR}/recipes-*/*/*.bbappend"

BBFILE_COLLECTIONS += "xt-prod-aos-domd"
BBFILE_PATTERN_xt-prod-aos-domd := "^${LAYERDIR}/"
BBFILE_PRIORITY_xt-prod-aos-domd = "7"

LAYERSERIES_COMPAT_xt-prod-aos-domd = "dunfell"
```
